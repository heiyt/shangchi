## shangchi_esp32/main/Kconfig.projbuild
```kconfig
menu "shangchi Configuration"

    menu "XPowersLib Configuration"
#         choice PMU_Type
#             prompt "XPowers chip type"
#             default XPOWERS_CHIP_AXP2101
#             config XPOWERS_CHIP_AXP2101
#                 bool "Xpowers AXP2101"
#         endchoice
        config I2C_MASTER_PORT_NUM
            int "PMU I2C Port Number"
            default 0
            help
                Port number for I2C Master device.
        config I2C_MASTER_FREQUENCY
            int "Master Frequency"
            default 100000
            help
                I2C Speed of Master device.
        config PMU_I2C_SCL
            int "PMU SCL GPIO Num"
            default 9
            help
                GPIO number for I2C PMU clock line.
        config PMU_I2C_SDA
            int "PMU SDA GPIO Num"
            default 8
            help
                GPIO number for I2C PMU data line.
        config PMU_INTERRUPT_PIN
            int "PMU Interrupt Pin"
            default 10
            help
                PMU interrupt pin.
    endmenu
#     choice
#         prompt "Peripheral device selection"
#         config NO_PERIPHERAL
#             bool "No peripheral device"
#         config OLED_ON
#             bool "Enable OLED Display"
#             help
#                 Enable OLED display connection and functionality.
#         config AHT10_ON
#             bool "Enable AHT10"
#             help
#                 Enable AHT10 temperature and humidity sensor.
#     endchoice
endmenu
```
